## uClinux-dist/linux-2.4.x/arch/frv/config.in
```kconfig
############################################################################# -*- sh -*-
#
# For a description of the syntax of this configuration file,
# see Documentation/kbuild/config-language.txt.
#
# based mainly on the arch/m68knommu/config.in
#
#############################################################################

mainmenu_name 'Fujitsu FR-V Kernel Configuration'

define_bool CONFIG_FUJITSU y
define_bool CONFIG_FRV y
define_bool CONFIG_UID16 y
define_bool CONFIG_RWSEM_GENERIC_SPINLOCK y
define_bool CONFIG_RWSEM_XCHGADD_ALGORITHM n
define_bool CONFIG_DM9000_ARCH_CONFIG y
define_bool CONFIG_NO_MMU_LARGE_ALLOCS y

#############################################################################

mainmenu_option next_comment
comment 'MMU support options'

choice 'Kernel Type' \
	"Linux		CONFIG_MMU_LINUX \
	 uCLinux	CONFIG_UCLINUX \
	" CONFIG_MMU_LINUX

endmenu

#############################################################################

mainmenu_option next_comment
comment 'Code maturity level options'
bool 'Prompt for development and/or incomplete code/drivers' CONFIG_EXPERIMENTAL
endmenu

#############################################################################

mainmenu_option next_comment
comment 'Loadable module support'
bool 'Enable loadable module support' CONFIG_MODULES
if [ "$CONFIG_MODULES" = "y" ]; then
   bool '  Set version information on all module symbols' CONFIG_MODVERSIONS
   bool '  Kernel module loader' CONFIG_KMOD
fi
endmenu

#############################################################################

mainmenu_option next_comment
comment 'Processor type and features'

choice 'CPU' \
	"FR40x/45x/55x	CONFIG_FR40x \
	 FR55x		CONFIG_FR55x " FR40x

comment 'Platform'

choice 'System' \
	"MB93091-VDK	CONFIG_MB93091_VDK \
	 MB93093-PDK	CONFIG_MB93093_PDK \
	" MB93091-VDK

if [ "$CONFIG_MB93091_VDK" = "y" ]; then
	choice 'Motherboard' \
		"MB93090-MB00	CONFIG_MB93090_MB00 \
		 None		CONFIG_MB93091_NO_MB \
		" MB93090-MB00 
fi

choice 'Kernel executes from' \
	"RAM	CONFIG_RAMKERNEL \
	 ROM	CONFIG_ROMKERNEL \
	 HIMEM  CONFIG_HIMEMKERNEL" ROM

if [ "$CONFIG_MMU_LINUX" = "y" ]; then
	choice 'High Memory Support' \
		"off    CONFIG_NOHIGHMEM \
		on     CONFIG_HIGHMEM \
		" on

	if [ "$CONFIG_HIGHMEM" = "y" ]; then
		bool 'HIGHMEM I/O support' CONFIG_HIGHIO
	fi
fi

bool 'Disable DCache' CONFIG_DCACHE_DISABLE

if [ "$CONFIG_DCACHE_DISABLE" = "n" ]; then
	choice 'Default cache-write mode' \
	         "Write-Through  CONFIG_FRV_DEFL_CACHE_WTHRU \
                  Write-Back     CONFIG_FRV_DEFL_CACHE_WBACK" Write-Through

	bool 'Disable cache write allocate' CONFIG_FRV_DEFL_CACHE_NWA
fi

bool 'Out-of-line the atomic operations' CONFIG_FRV_OUTOFLINE_ATOMIC_OPS

endmenu

#############################################################################

mainmenu_option next_comment
comment 'General setup'

bool 'Networking support' CONFIG_NET

if [ "$CONFIG_MB93091_VDK" = "y" ]; then
	bool 'PCI support' CONFIG_PCI
fi

if [ "$CONFIG_UCLINUX" = "y" ]; then
	bool 'Reserve memory uncached for (PCI) DMA' CONFIG_RESERVE_DMA_CONSISTENT
fi

define_bool CONFIG_SMP n

source drivers/pci/Config.in

bool 'Support for hot-pluggable devices' CONFIG_HOTPLUG

if [ "$CONFIG_HOTPLUG" = "y" ] ; then
   source drivers/pcmcia/Config.in
else
   define_bool CONFIG_PCMCIA n
fi

bool 'System V IPC' CONFIG_SYSVIPC
bool 'BSD Process Accounting' CONFIG_BSD_PROCESS_ACCT
bool 'Sysctl support' CONFIG_SYSCTL
if [ "$CONFIG_PROC_FS" = "y" ]; then
   choice 'Kernel core (/proc/kcore) format' \
	"ELF		CONFIG_KCORE_ELF	\
	 A.OUT		CONFIG_KCORE_AOUT" ELF
fi
tristate 'Kernel support for flat binaries' CONFIG_BINFMT_FLAT
if [ "$CONFIG_BINFMT_FLAT" != "n" ]; then
   bool '    Enable ZFLAT support' CONFIG_BINFMT_ZFLAT
   bool '    Enable shared FLAT support' CONFIG_BINFMT_SHARED_FLAT
fi
tristate 'Kernel support for a.out binaries' CONFIG_BINFMT_AOUT
tristate 'Kernel support for ELF binaries' CONFIG_BINFMT_ELF
tristate 'Kernel support for ELF-FDPIC binaries' CONFIG_BINFMT_ELF_FDPIC
tristate 'Kernel support for MISC binaries' CONFIG_BINFMT_MISC

if [ "$CONFIG_UCLINUX" = "y" ]; then
    bool 'Kernel image protection' CONFIG_PROTECT_KERNEL
fi

bool 'Power Management support' CONFIG_PM

endmenu

#############################################################################

source drivers/mtd/Config.in

source drivers/fujitsu/Config.in

source drivers/frv_acpi/Config.in

source drivers/block/Config.in

if [ "$CONFIG_NET" = "y" ]; then
   source net/Config.in
fi

source drivers/telephony/Config.in

#############################################################################

mainmenu_option next_comment
comment 'ATA/IDE/MFM/RLL support'

tristate 'ATA/IDE/MFM/RLL support' CONFIG_IDE

if [ "$CONFIG_IDE" != "n" ]; then
  source drivers/ide/Config.in
else
  define_bool CONFIG_BLK_DEV_IDE_MODES n
  define_bool CONFIG_BLK_DEV_HD n
fi
endmenu

#############################################################################

mainmenu_option next_comment
comment 'SCSI support'

tristate 'SCSI support' CONFIG_SCSI

if [ "$CONFIG_SCSI" != "n" ]; then
   source drivers/scsi/Config.in
fi
endmenu

#############################################################################

source drivers/ieee1394/Config.in

source drivers/message/i2o/Config.in

if [ "$CONFIG_NET" = "y" ]; then
   mainmenu_option next_comment
   comment 'Network device support'

   bool 'Network device support' CONFIG_NETDEVICES
   if [ "$CONFIG_NETDEVICES" = "y" ]; then
      source drivers/net/Config.in
      if [ "$CONFIG_ATM" = "y" ]; then
         source drivers/atm/Config.in
      fi
   fi
   endmenu
fi

source net/ax25/Config.in

source net/irda/Config.in

#############################################################################

mainmenu_option next_comment
comment 'ISDN subsystem'
if [ "$CONFIG_NET" != "n" ]; then
   tristate 'ISDN support' CONFIG_ISDN
   if [ "$CONFIG_ISDN" != "n" ]; then
      source drivers/isdn/Config.in
   fi
fi
endmenu

#############################################################################

mainmenu_option next_comment
comment 'Old CD-ROM drivers (not SCSI, not IDE)'

bool 'Support non-SCSI/IDE/ATAPI CDROM drives' CONFIG_CD_NO_IDESCSI
if [ "$CONFIG_CD_NO_IDESCSI" != "n" ]; then
   source drivers/cdrom/Config.in
fi
endmenu

#############################################################################

source drivers/char/Config.in


#source drivers/misc/Config.in

source fs/Config.in

if [ "$CONFIG_VT" = "y" ]; then
   mainmenu_option next_comment
   comment 'Console drivers'
   bool 'VGA text console' CONFIG_VGA_CONSOLE
   bool 'Video mode selection support' CONFIG_VIDEO_SELECT
   if [ "$CONFIG_EXPERIMENTAL" = "y" ]; then
      tristate 'MDA text console (dual-headed) (EXPERIMENTAL)' CONFIG_MDA_CONSOLE
      source drivers/video/Config.in
   fi
   endmenu
fi

#############################################################################

mainmenu_option next_comment
comment 'Sound'

tristate 'Sound card support' CONFIG_SOUND
if [ "$CONFIG_SOUND" != "n" ]; then
   source drivers/sound/Config.in
fi
endmenu

#############################################################################

source drivers/usb/Config.in

#############################################################################

mainmenu_option next_comment
comment 'Kernel hacking'

bool 'Full Symbolic/Source Debugging support' CONFIG_FULLDEBUG
bool 'Garbage-collect sections' CONFIG_GC_SECTIONS
#bool 'Debug kmalloc/kfree' CONFIG_DEBUG_MALLOC
bool 'Magic SysRq key' CONFIG_MAGIC_SYSRQ
if [ "$CONFIG_EXPERIMENTAL" = "y" ]; then
	bool 'Non power-of-2 kernel allocator (EXPERIMENTAL)' CONFIG_CONTIGUOUS_PAGE_ALLOC
	dep_bool '  include /proc/mem_map' CONFIG_MEM_MAP $CONFIG_CONTIGUOUS_PAGE_ALLOC
fi

bool 'Kernel profiling support' CONFIG_PROFILE
if [ "$CONFIG_PROFILE" = "y" ]; then
  int ' Profile shift count' CONFIG_PROFILE_SHIFT 2
  bool 'Use fast second timer for profiling' CONFIG_HIGHPROFILE
fi

bool 'Suppress Kernel BUG Messages' CONFIG_NO_KERNEL_MSG
bool '  Debug memory allocations' CONFIG_DEBUG_SLAB

bool 'Reduce kernel task size to 1 page' CONFIG_SMALL_TASKS

bool 'Compiled-in Kernel Boot Parameter' CONFIG_BOOTPARAM
if [ "$CONFIG_BOOTPARAM" = "y" ]; then
  string 'Kernel Boot Parameter' CONFIG_BOOTPARAM_STRING ""
fi

bool '  In-kernel GDB stub' CONFIG_GDBSTUB
if [ "$CONFIG_GDBSTUB" != "n" ]; then
    if [ "$CONFIG_MB93093_PDK" = "y" ]; then
	define_bool CONFIG_GDBSTUB_UART0 y
    else
	define_bool CONFIG_GDBSTUB_UART1 y
    fi
    bool '    Immediate activation' CONFIG_GDBSTUB_IMMEDIATE
    bool '    Console through GDB stub' CONFIG_GDBSTUB_CONSOLE
fi

endmenu


#############################################################################

source crypto/Config.in
source lib/Config.in

#############################################################################
```
