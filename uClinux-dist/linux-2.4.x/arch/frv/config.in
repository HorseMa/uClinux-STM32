## uClinux-dist/linux-2.4.x/net/ipv6/Config.in
```kconfig
# $USAGI: Config.in,v 1.80 2004/01/31 09:27:11 yoshfuji Exp $
#
# IPv6 configuration
#

#mainmenu_option next_comment
#comment '  IPv6 Configuration'

# --- overall ---
bool '    IPv6: Verbose debugging messages' CONFIG_IPV6_DEBUG

# --- module interface ---
if [ "$CONFIG_IPV6" = "m" ]; then
   bool '    IPv6: inter-module support.' CONFIG_IPV6_IM
   if [ "$CONFIG_NET_IPGRE" != "n" ]; then
      bool '      IPv6: enable gre tunnel support with modulized ipv6' CONFIG_IPV6_MODULE_IP_GRE
   fi
fi

# --- IPv6 Specification (RFC2460) and Addressing Architecture (RFC2373) ---
bool '    IPv6: Scoped routing' CONFIG_IPV6_ZONE
if [ "$CONFIG_IPV6_ZONE" = "y" ]; then
   bool '      IPv6: Site-border routing by default' CONFIG_IPV6_ZONE_SITELOCAL
fi
#bool '    IPv6: Loose scope_id' CONFIG_IPV6_LOOSE_SCOPE_ID
bool '    IPv6: drop packets with fake ipv4-mapped address(es)' CONFIG_IPV6_DROP_FAKE_V4MAPPED
if [ "$CONFIG_IPV6" = "y" -o "$CONFIG_IPV6_IM" = "y" ]; then
   bool '    IPv6: Restrict "double binding" only for same user' CONFIG_IPV6_RESTRICTED_DOUBLE_BIND
fi
bool '    IPv6: 6to4-address in nexthop support.' CONFIG_IPV6_6TO4_NEXTHOP
bool '    IPv6: Privacy Extensions (RFC 3041) support' CONFIG_IPV6_PRIVACY
dep_tristate '    IPv6: IPv6 over IPv6 Tunneling (EXPERIMENTAL)' CONFIG_IPV6_IPV6_TUNNEL m

# --- NDP (RFC2461) ---
bool '    IPv6: Prefix List support' CONFIG_IPV6_PREFIXLIST
define_bool CONFIG_IPV6_NDISC_NEW y
if [ "$CONFIG_IPV6_DEBUG" = "y" ]; then
   bool '    IPv6: Neighbor Discovery debugging' CONFIG_IPV6_NDISC_DEBUG
fi

# --- Stateless Address Configuration (RFC2462) ---
if [ "$CONFIG_IPV6_DEBUG" = "y" ]; then
   bool '    IPv6: Address Autoconfigration debugging' CONFIG_IPV6_ACONF_DEBUG
   if [ "$CONFIG_IPV6_ACONF_DEBUG" = "y" ]; then
      bool '      IPv6: Debug on source address selection' CONFIG_IPV6_ACONF_DEBUG_SADDR
   fi
fi

# --- Routing ---
if [ "$CONFIG_IPV6_DEBUG" = "y" ]; then
   bool '    IPv6: Routing Information debugging' CONFIG_IPV6_RT6_DEBUG
fi
bool '    IPv6: sub-tree in routing table support (just for testing)' CONFIG_IPV6_SUBTREES
bool '    IPv6: default router preference' CONFIG_IPV6_ROUTER_PREF
if [ "$CONFIG_IPV6_ROUTER_PREF" != "n" ]; then
	#bool '    IPv6: new round-robin architecture' CONFIG_IPV6_NEW_ROUNDROBIN
	define_bool CONFIG_IPV6_NEW_ROUNDROBIN y
	bool '      IPv6: Route Information Option support' CONFIG_IPV6_ROUTE_INFO
fi

# --- MLD (RFC2710) ---
if [ "$CONFIG_IPV6_DEBUG" = "y" ]; then
   bool '    IPv6: Multicast Listener Discovery debugging' CONFIG_IPV6_MLD6_DEBUG
fi
bool '    IPv6: disable optimization MLD6 Done message' CONFIG_IPV6_MLD6_ALL_DONE

# --- Node Information Queries (Internet Draft) ---
bool '    IPv6: enable Node Information Queries' CONFIG_IPV6_NODEINFO
if [ "$CONFIG_IPV6_NODEINFO" = "y" ]; then
   if [ "$CONFIG_IPV6_DEBUG" = "y" ]; then
       bool '      IPv6: Node Information Queries debugging' CONFIG_IPV6_NODEINFO_DEBUG
   fi
   bool '      IPv6: regard NIS domain as DNS domain' CONFIG_IPV6_NODEINFO_USE_UTS_DOMAIN
fi

# --- Socket Interface (RFC2292/3542, RFC2553/3493) ---

# --- Filtering ---
if [ "$CONFIG_NETFILTER" != "n" ]; then
   source net/ipv6/netfilter/Config.in
fi

# --- Misc. ---
# 
#bool '    IPv6: flow policy support' CONFIG_RT6_POLICY
#bool '    IPv6: firewall support' CONFIG_IPV6_FIREWALL

# -- IPsec --

# --- Mobile IP ---

#endmenu
```

## uClinux-dist/linux-2.6.x/arch/arm/mach-ks8695/Kconfig
```kconfig
if ARCH_KS8695

menu "Kendin/Micrel KS8695 Implementations"

config MACH_KS8695
	bool "KS8695 development board"
	help
	  Say 'Y' here if you want your kernel to run on the original
	  Kendin-Micrel KS8695 development board.

config MACH_LITE300
	bool "SecureComputing SG300"
	help
	  Say 'Y' here if you want your kernel to support the
	  SecureComputing / SnapGear SG300 VPN Internet Router.
	  See http://www.securecomputing.com for more details.

config MACH_SG310
	bool "SecureComputing SG310"
	help
	  Say 'Y' here if you want your kernel to support the
	  SecureComputing / SnapGear SG310 VPN Internet Router.
	  See http://www.securecomputing.com for more details.

config MACH_PFW
	bool "SecureComputing PFW"
	help
	  Say 'Y' here if you want your kernel to support the
	  SecureComputing / Personal FireWall device.
	  See http://www.securecomputing.com for more details.

config MACH_SE4200
	bool "SecureComputing SE4200"
	help
	  Say 'Y' here if you want your kernel to support the
	  SecureComputing / SnapGear SE4200 Secure Wireless VPN
	  Internet Router.
	  See http://www.securecomputing.com for more details.

config MACH_CM4002
	bool "OpenGear CM4002"
	help
	  Say 'Y' here if you want your kernel to support the OpenGear
	  CM4002 Secure Access Server. See http://www.opengear.com for
	  more details.

config MACH_CM4008
	bool "OpenGear CM4008"
	help
	  Say 'Y' here if you want your kernel to support the OpenGear
	  CM4008 Console Server. See http://www.opengear.com for more
	  details.

config MACH_CM40xx
	bool "OpenGear CM40xx"
	help
	  Say 'Y' here if you want your kernel to support the OpenGear
	  CM4016 or CM4048 Console Servers. See http://www.opengear.com for
	  more details.

endmenu

endif
```

## uClinux-dist/linux-2.6.x/arch/arm/mach-lpc28xx/Kconfig
```kconfig
#	linux/arch/arm/mach-lpc28xx/Kconfig	
#	Copyright (C) 2007 NXP
#

menu "NXP LPC28xx Options"
	depends on ARCH_LPC28XX

config MACH_LPC28XX
        bool
        default y
        help
                Phillips LPC28XX Family

config LPC28XX_XTAL
    int	"Oscillator Frequency"
    default 12000000
    help
	Oscillator frequency. The defualt is 12MHz. 
	Change it according to your board.
	
config ARM_CLK
	int 'Arm Core Clock'
	default 60000000
	help
	CPU core clock frequency. The default is 60MHz.
	Change it according to your application needs.

endmenu
```

## uClinux-dist/linux-2.6.x/arch/arm/mach-stm3210e_eval/Kconfig
```kconfig
menu "STMicroelectronics, boards"

config MACH_STM3210E_EVAL
	bool "Supports for STM3210E-EVAL eval board."
	default y
	select ARM_NVIC
	help
	  Include support for the STMicroelectronic STM3210E-EVAL board.

endmenu
```

## uClinux-dist/linux-2.6.x/arch/nios2nommu/Kconfig
```kconfig
#
# For a description of the syntax of this configuration file,
# see the Configure script.
#
mainmenu 'uClinux/Nios2 (w/o MMU) Kernel Configuration'

config MMU
	bool
	default n

config FPU
	bool
	default n

config ZONE_DMA
	bool
	default y

config NO_DMA
	bool
	default y

config UID16
	bool
	default y

config RWSEM_GENERIC_SPINLOCK
	bool
	default y

config RWSEM_XCHGADD_ALGORITHM
	bool
	default n

config GENERIC_FIND_NEXT_BIT
	bool
	default y

config GENERIC_HWEIGHT
	bool
	default y

config GENERIC_CALIBRATE_DELAY
	bool
	default y

config GENERIC_TIME
	bool
	default y

config HOTPLUG_CPU
	bool
	default n

config ARCH_SUPPORTS_AOUT
	def_bool y

source "init/Kconfig"

menu "Processor type and features"

comment 'Platform dependant setup'

source "kernel/time/Kconfig"

choice
	prompt "CPU"
	default NIOS2

config NIOS2
	bool "NIOS2"
	help
	  Altera Nios2 softcore processor.

endchoice

choice
	prompt "Platform"
	default ALTERA_STRATIX

config MICROTRONIX_UKIT
	bool "Microtronix uKit board support"
	depends on NIOS2
	help
	  Support for the Microtronix uKit development board. Includes support 
	  for Sodimm SDRAM/FLASH, soft ethernet MAC & PHY.

config MICROTRONIX_STRATIX
	bool "Microtronix Stratix board support"
	depends on NIOS2
	help
	  Support for the Microtronix Stratix board. Includes support 
	  for Sodimm SDRAM/FLASH, soft ethernet MAC & PHY, USB, LVDS
	  & analog/digital converters.

config MICROTRONIX_CYCLONE
	bool "Microtronix Cyclone board support"
	depends on NIOS2
	help
	  Support for the Microtronix Cyclone board. Includes support 
	  for SDRAM, FLASH, soft ethernet MAC & PHY, USB,
	  & analog/digital converters.

config MICROTRONIX_PSK
	bool "Microtronix PSK (Product Starter Kit) support"
	depends on NIOS2
	help
	  Support for the Microtronix PSK (Product Starter Kit), which
	  features firefly module (EP1C4 or EP1C12). Includes support 
	  for SDRAM, FLASH, and a variety of product expansion kits such
	  as USB, Ethernet etc.

config ALTERA_STRATIX
	bool "Altera Stratix Development board support"
	depends on NIOS2
	help
	  Support for the Altera Stratix Development board. Includes
	  support for 10/100 ethernet, FLASH, SDRAM, compact flash.

config ALTERA_STRATIX_PRO
	bool "Altera Stratix Pro Development board support"
	depends on NIOS2
	help
	  Support for the Altera Stratix 1s40 Development board. Includes
	  support for 10/100 ethernet, FLASH, SDRAM, compact flash.

config ALTERA_STRATIX_II
	bool "Altera Stratix II Development board support"
	depends on NIOS2
	help
	  Support for the Altera Stratix II Development board. Includes
	  support for 10/100 ethernet, FLASH, SDRAM, compact flash.

config ALTERA_CYCLONE
	bool "Altera Cyclone Development board support"
	depends on NIOS2
	help
	  Support for the Altera Cyclone Development board. Includes
	  support for 10/100 ethernet, FLASH, SDRAM, compact flash.

config ALTERA_CYCLONE_1C12_EVAL
	bool "Altera Cyclone 1C12 Evaluation board support"
	depends on NIOS2
	help
	  Support for the Altera Cyclone 1C12 Evaluation board (with the
	  embedded processor module).

config ALTERA_DE2
	bool "Altera DE2 Development board support"
	depends on NIOS2
	help
	  Support for the Altera Cyclone Development board. Includes
	  support for 10/100 ethernet, FLASH, SDRAM, VGA, I2C.

endchoice

choice
	prompt "Nios II Hardware Multiply Support"
	default NIOS2_HW_MULX
	help
	  This option enables various assembler instructions based on your
	  selection.  The choice depends on what target hardware you'll be
	  running your applications on.  The default is 
	  "Enable mulx instruction".
	  
	  Here is an explanation of each option:
	  None = -mno-hw-mul -mno-hw-mulx
	   (no mul or mulx instructions used)
	  Enable mul instruction = -mhw-mul -mno-hw-mulx 
	   (use mul instructions)
	  Enable mul and mulx instructions = -mhw-mul -mhw-mulx
	   (use mul and mulx instructions)
	  
	  If you don't know what to choose, select "Enable mulx instruction".
	
config NIOS2_HW_MUL_OFF
	bool "None"

config NIOS2_HW_MUL
	bool "Enable mul instruction"

config NIOS2_HW_MULX
	bool "Enable mul and mulx instructions"
	
endchoice

comment 'Platform drivers Options'

config AVALON_DMA
	bool "Support of DMA controller with Avalon interface"
	default y
	help
	  This enables support of Altera's DMA controller with Avalon
	  interface, so that drivers of DMA-able device can use this 
	  interface.
	
config PIO_DEVICES
	bool "Enable leds, seven segment display"
	default y
	depends on (ALTERA_STRATIX || ALTERA_STRATIX_PRO || ALTERA_CYCLONE)
	help
	  This enables example code to support leds, and seven segment
	  display as PIO devices. Once enabled, the kernel will show a
	  counter (increas once a second) on these devices.

source "arch/nios2nommu/drivers/Kconfig"

comment 'Miscellaneous Options'

config EXCALIBUR
	bool
	default y
	depends on (NIOS2)

config BREAK_ON_START
	bool "Include breakpoint trap on kernel startup"
	help
	  Configures the kernel to trap to the GDB client on startup
	  before the kernel starts initialization. This allows you to
	  debug the kernel startup.

config FORCE_MAX_ZONEORDER
	int
	default "14" 

choice
	prompt "Kernel executes from"
	---help---
	  Choose the memory type that the kernel will be running in.

config RAMKERNEL
	bool "RAM"
	help
	  The kernel will be resident in RAM when running.

#config ROMKERNEL
#	bool "ROM"
#	help
#	  The kernel will be resident in FLASH/ROM when running.

#config HIMEMKERNEL
#	bool "HIMEM"
#	help
#	  The kernel will be resident in high memory when running.

endchoice

source "kernel/Kconfig.preempt"

source kernel/Kconfig.hz

config CMDLINE
	string "Default kernel command string"
	default "CONSOLE=/dev/ttyS0 root=/dev/rom0 ro"
	help
	  On some architectures, there is currently no way
	  for the boot loader to pass arguments to the kernel. For these
	  architectures, you should supply some command-line options at build
	  time by entering them here. As a minimum, you should specify the
	  memory size and the root device (e.g., mem=64M root=/dev/nfs).

config PASS_CMDLINE
	bool "Passed kernel command line from u-boot"
	default n
	help
	  Use bootargs env variable from u-boot for kernel command line.
	  will override "Default kernel command string".
          Say N if you are unsure.

source "mm/Kconfig"

config BOOT_LINK_OFFSET
	hex "Link address offset for booting"
	default "0x00500000"
	help
	  This option allows you to set the link address offset of the zImage.
	  This can be useful if you are on a board which has a small amount of
	  memory.

endmenu

menu "Bus options (PCI, PCMCIA, EISA, MCA, ISA)"

config PCI
	bool "PCI support"
	help
	  Support for PCI bus.

source "drivers/pci/Kconfig"

config HOTPLUG
	bool "Support for hot-pluggable device"
	  help
	  Say Y here if you want to plug devices into your computer while
	  the system is running, and be able to use them quickly.  In many
	  cases, the devices can likewise be unplugged at any time too.

	  One well known example of this is PCMCIA- or PC-cards, credit-card
	  size devices such as network cards, modems or hard drives which are
	  plugged into slots found on all modern laptop computers.  Another
	  example, used on modern desktops as well as laptops, is USB.

	  Enable HOTPLUG and KMOD, and build a modular kernel.  Get agent
	  software (at <http://linux-hotplug.sourceforge.net/>) and install it.
	  Then your kernel will automatically call out to a user mode "policy
	  agent" (/sbin/hotplug) to load modules and set up software needed
	  to use devices as you hotplug them.

source "drivers/pcmcia/Kconfig"

source "drivers/pci/hotplug/Kconfig"

endmenu

menu "Executable file formats"

source "fs/Kconfig.binfmt"

endmenu

menu "Power management options"

source "kernel/power/Kconfig"

endmenu

source "net/Kconfig"

source "drivers/Kconfig"

source "fs/Kconfig"

source "arch/nios2nommu/Kconfig.debug"

source "security/Kconfig"

source "crypto/Kconfig"

source "lib/Kconfig"
```

## uClinux-dist/linux-2.6.x/arch/nios2nommu/drivers/Kconfig
```kconfig
# Platfrom drivers configuration

source "arch/nios2nommu/drivers/pci/Kconfig"

config FB_ALTERA
	tristate "Avalon VGA controller support"
	default N
	select FB
	select FB_CFB_FILLRECT
	select FB_CFB_COPYAREA
	select FB_CFB_IMAGEBLIT
	help
	  This is the frame buffer device driver for the VGA controller 
	  in SOPC Builder.

config SERIO_ALTPS2
	tristate "PS2 controller"
	select VT
	default N
	select SERIO

config I2C_NIOS2_GPIO
	tristate "GPIO-Based I2C Interface"
	default N
	select I2C
	select I2C_ALGOBIT
	help
	  Say Y here if you use GPIO lines for an I2C bus.

config BLK_DEV_ALTCF
	tristate "Altera CF (IDE mode) interface (Avalon bus) support"
	select IDE
	select BLK_DEV_IDE
	default N
	help
	  This driver provides support for the Altera Compact flash core (with
	  Avalon interface) support. If you have an Altera or Microtronix
	  development board you can build support into the FPGA device for this.

config NIOS_SPI
	bool "Nios SPI device support"
	depends on NIOS || NIOS2
	help
	  This driver supports the Nios softcore SPI device.

config NIOS_SD_HOST
	tristate "NIOS SD/SDIO/MMC Host"
	depends on NIOS || NIOS2
	help
		This driver supports the FPS-Tech SD/SDIO/MMC Host IP
```

## uClinux-dist/linux-2.6.x/arch/um/Kconfig.arch.rej
```kconfig
--- linux-2.6.x/arch/um/Kconfig.arch	2008-04-22 11:37:47.000000000 +1000
+++ linux-2.6.x/arch/um/Kconfig.arch	2008-07-24 10:12:08.000000000 +1000
@@ -19,10 +19,6 @@
 	bool
 	default n
 
-config SEMAPHORE_SLEEPERS
-	bool
-	default y
-
 config 3_LEVEL_PGTABLES
 	bool "Three-level pagetables (EXPERIMENTAL)"
 	default n
```
